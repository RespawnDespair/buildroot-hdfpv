## Config.in
```kconfig
# make the variant name available as a Config.in variable
#
# you can use BR2SM_PROJECT_NAME to have some options only appear for some variants
#
config BR2SM_PROJECT_NAME
	string
	option env="PROJECT_NAME"

# External packages
source "$BR2_EXTERNAL_BUILDROOT_SUBMODULE_PATH/packages/wifibroadcast/Config.in"
source "$BR2_EXTERNAL_BUILDROOT_SUBMODULE_PATH/packages/wifibroadcast-osd/Config.in"
source "$BR2_EXTERNAL_BUILDROOT_SUBMODULE_PATH/packages/wifibroadcast-scripts/Config.in"
```

## defconfig
```kconfig
BR2_arm=y
BR2_arm1176jzf_s=y
BR2_ARM_EABIHF=y
BR2_DL_DIR="$(BR2_EXTERNAL_BUILDROOT_SUBMODULE_PATH)/dl"
BR2_PACKAGE_OVERRIDE_FILE="$(BR2_EXTERNAL_BUILDROOT_SUBMODULE_PATH)/local.mk"
BR2_GLOBAL_PATCH_DIR="$(BR2_EXTERNAL_BUILDROOT_SUBMODULE_PATH)/patch"
BR2_PACKAGE_HOST_LINUX_HEADERS_CUSTOM_4_9=y
BR2_TOOLCHAIN_BUILDROOT_CXX=y

BR2_LINUX_KERNEL=y
BR2_LINUX_KERNEL_CUSTOM_GIT=y
BR2_LINUX_KERNEL_CUSTOM_REPO_URL="https://github.com/raspberrypi/linux.git"
BR2_LINUX_KERNEL_CUSTOM_REPO_VERSION="be2540e540f5442d7b372208787fb64100af0c54"
BR2_LINUX_KERNEL_DEFCONFIG="bcmrpi"
BR2_LINUX_KERNEL_PATCH="$(BR2_EXTERNAL_BUILDROOT_SUBMODULE_PATH)/kernel-patches"

# Build the DTBs for A/B from the kernel sources: the zero is the same
# as the A+ model, just in a different form-factor
BR2_LINUX_KERNEL_DTS_SUPPORT=y
BR2_LINUX_KERNEL_INTREE_DTS_NAME="bcm2708-rpi-b-plus"

BR2_PACKAGE_RPI_FIRMWARE=y
# BR2_PACKAGE_RPI_FIRMWARE_INSTALL_DTB_OVERLAYS is not set

# Rootfs image
BR2_TARGET_ROOTFS_EXT2_SIZE="200M"
BR2_TARGET_ROOTFS_EXT2=y
BR2_TARGET_ROOTFS_EXT2_4=y
# BR2_TARGET_ROOTFS_TAR is not set
BR2_PACKAGE_HOST_DOSFSTOOLS=y
BR2_PACKAGE_HOST_GENIMAGE=y
BR2_PACKAGE_HOST_MTOOLS=y
BR2_ROOTFS_OVERLAY="$(BR2_EXTERNAL_BUILDROOT_SUBMODULE_PATH)/overlay"
BR2_ROOTFS_POST_BUILD_SCRIPT="board/raspberrypi0/post-build.sh"
BR2_ROOTFS_POST_IMAGE_SCRIPT="board/raspberrypi0/post-image.sh"

# Toolchain needs to be glibc
# BR2_TOOLCHAIN_BUILDROOT_UCLIBC is not set
BR2_TOOLCHAIN_BUILDROOT_GLIBC=y
# BR2_TOOLCHAIN_BUILDROOT_MUSL is not set
BR2_TOOLCHAIN_BUILDROOT_LIBC="glibc"
BR2_PACKAGE_LINUX_HEADERS=y
BR2_PACKAGE_GLIBC=y
# BR2_GLIBC_VERSION_2_22 is not set
BR2_GLIBC_VERSION_2_23=y
BR2_GLIBC_VERSION_STRING="2.23"

# Required packages
BR2_PACKAGE_LIBPCAP=y
BR2_PACKAGE_RPI_USERLAND=y
# required for hello_video.bin, patch is already included
BR2_PACKAGE_RPI_USERLAND_HELLO=y
BR2_PACKAGE_IW=y
BR2_PACKAGE_WIRELESS_REGDB=y
BR2_PACKAGE_WIRELESS_TOOLS=y
BR2_PACKAGE_WIRINGPI=y
BR2_PACKAGE_WIFIBROADCAST=y
BR2_PACKAGE_WIFIBROADCASTOSD=y

BR2_TARGET_ROOTFS_CPIO=y
# BR2_TARGET_ROOTFS_CPIO_NONE is not set
# BR2_TARGET_ROOTFS_CPIO_GZIP is not set
# BR2_TARGET_ROOTFS_CPIO_BZIP2 is not set
# BR2_TARGET_ROOTFS_CPIO_LZMA is not set
BR2_TARGET_ROOTFS_CPIO_LZO=y
BR2_TARGET_ROOTFS_INITRAMFS=y
```

## packages/wifibroadcast-osd/Config.in
```kconfig
config BR2_PACKAGE_WIFIBROADCASTOSD
	bool "wifibroadcastosd"
	depends on BR2_TOOLCHAIN_USES_GLIBC
	select BR2_PACKAGE_LIBPCAP # libpcap
	select BR2_PACKAGE_OPENGL
	select BR2_PACKAGE_HAS_LIBOPENVG
	help
	  This will install Befi's wifibroadcast osd

	  https://bitbucket.org/befi/frsky_omx_osd

comment "wifibroadcastosd needs a glibc toolchain"
	depends on !BR2_TOOLCHAIN_USES_GLIBC
```

## packages/wifibroadcast-scripts/Config.in
```kconfig
config BR2_PACKAGE_WIFIBROADCASTSCRIPTS
	bool "wifibroadcastscripts"
	help
	  This will install start scripts for Befi's wifibroadcast

	  https://bitbucket.org/befi/wifibroadcast_fpv_scripts
```

## packages/wifibroadcast/Config.in
```kconfig
config BR2_PACKAGE_WIFIBROADCAST
	bool "wifibroadcast"
	depends on BR2_TOOLCHAIN_USES_GLIBC
	select BR2_PACKAGE_LIBPCAP # libpcap
	select BR2_PACKAGE_IW # iw
	select BR2_PACKAGE_WIRELESS_TOOLS # iwconfig and so on
	select BR2_PACKAGE_WIRELESS_REGDB # really needed?
	select BR2_PACKAGE_RPI_USERLAND # raspivid + hello_video
	select BR2_PACKAGE_WIRINGPI
	help
	  This will install Befi's wifibroadcast

	  https://bitbucket.org/befi/wifibroadcast

comment "wifibroadcast needs a glibc toolchain"
	depends on !BR2_TOOLCHAIN_USES_GLIBC
```
